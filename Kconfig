## Kconfig
```kconfig
# Copyright (c) 2019 Nordic Semiconductor
#
# SPDX-License-Identifier: LicenseRef-Nordic-5-Clause
#

DT_COMPAT_ZMK_BEHAVIOR_BATT_LR_PRINTER := zmk,behavior-battery-lr-printer

config ZMK_BEHAVIOR_BATT_LR_PRINTER
	bool
	default $(dt_compat_enabled,$(DT_COMPAT_ZMK_BEHAVIOR_BATT_LR_PRINTER))
```

## boards/shields/o54gosw/Kconfig.defconfig
```kconfig
if SHIELD_O54GOSW_LEFT

config ZMK_KEYBOARD_NAME
    default "o54gosw"

endif

if SHIELD_O54GOSW_LEFT || SHIELD_O54GOSW_RIGHT

config ZMK_SPLIT
    default y

endif
```

## boards/shields/o54gosw/Kconfig.shield
```kconfig
config SHIELD_O54GOSW_LEFT
    def_bool $(shields_list_contains,o54gosw_left)
config SHIELD_O54GOSW_RIGHT
    def_bool $(shields_list_contains,o54gosw_right)
```

## dts/bindings/zmk,behavior-battery-lr-printer.yaml
```yaml
# SPDX-License-Identifier: MIT

description: "Behavior that types left/right battery percentages."

compatible: "zmk,behavior-battery-lr-printer"

include: zero_param.yaml
```
